## boards/shields/tiny18_standalone/Kconfig.defconfig
```kconfig
if SHIELD_TINY18_STANDALONE_L || SHIELD_TINY18_STANDALONE_R
config ZMK_KEYBOARD_NAME
    default "Tiny18 Solo L" if SHIELD_TINY18_STANDALONE_L
    default "Tiny18 Solo R" if SHIELD_TINY18_STANDALONE_R
config ZMK_SPLIT
    default n
config RGBLED_WIDGET_BATTERY_LEVEL_HIGH
    default 30
config RGBLED_WIDGET_BATTERY_LEVEL_CRITICAL
    default 10
endif
```

## boards/shields/tiny18_standalone/Kconfig.shield
```kconfig
config SHIELD_TINY18_STANDALONE_L
    def_bool $(shields_list_contains,tiny18_standalone_l)

config SHIELD_TINY18_STANDALONE_R
    def_bool $(shields_list_contains,tiny18_standalone_r)
```
